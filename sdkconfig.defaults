## tools/lp_native_615h5/sdkconfig.defaults
```kconfig
CONFIG_IDF_TARGET="esp32p4"
CONFIG_ULP_COPROC_ENABLED=y
CONFIG_ULP_COPROC_TYPE_LP_CORE=y
CONFIG_ULP_COPROC_RESERVE_MEM=28672
CONFIG_RTC_FAST_CLK_SRC_XTAL=y
# CONFIG_RTC_FAST_CLK_SRC_RC_FAST is not set
# CONFIG_ULP_COPROC_RUN_FROM_HP_MEM is not set
CONFIG_ULP_PANIC_OUTPUT_ENABLE=n
```
